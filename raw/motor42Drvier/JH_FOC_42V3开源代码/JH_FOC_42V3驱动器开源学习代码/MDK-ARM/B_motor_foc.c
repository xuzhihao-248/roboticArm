	/*！！！！！！作者声明！！！！！！！！ */
/**
  ******************************************************************************
  * JH_FOC_42V3步进电机FOC驱动器开源代码
	* 该代码已实现步进电机开环，电流闭环，速度-电流闭环，角度-电流闭环，电机非线性校准等
  * 注意该代码中的位置环代码绝大部分由AI生成，并非原厂位置环代码，控制效果不如原厂，需要自己优化！！
	* 注意该代码中的位置环代码绝大部分由AI生成，并非原厂位置环代码，控制效果不如原厂，需要自己优化！！
	* 注意该代码中的位置环代码绝大部分由AI生成，并非原厂位置环代码，控制效果不如原厂，需要自己优化！！
  ******************************************************************************
	* 代码绝大部分都是作者书写，或有不足，敬请指正！
	* 作者能力有限，代码可能阅读性不是特别友好，望包涵！
	  ******************************************************************************
	
	* 最后重点声明：该代码仅用于学习交流，禁止任何商业用途！！！！！
									该代码仅用于学习交流，禁止任何商业用途！！！！！
									该代码仅用于学习交流，禁止任何商业用途！！！！！
									该代码仅用于学习交流，禁止任何商业用途！！！！！
									该代码仅用于学习交流，禁止任何商业用途！！！！！
  ******************************************************************************
	                                                     
																					版权所有		
																							淘宝店铺：JHive智控
																				      店铺链接：https://shop355919857.taobao.com/?spm=a21xtw.29978518.0.0
	                                                                 2026年7月8日
																																	 
	******************************************************************************
  */

#include "B_motor_foc.h"
#include "tim.h"
#include "mos_set.h"
#include "math.h"
#include "adc.h"
#include "adc_task.h"
#include "filter.h"
#include "myflash.h"
#include "MT6816.H"
#include "pid.h"
 foc_TypeDef m1_foc;
 
 //ROM太小，直接存在RAM中
 float sin_value[1024]={0,0.00613588,0.0122715,0.0184067,0.0245412,0.0306748,0.0368072,0.0429383,0.0490677,0.0551952,0.0613207,0.0674439,0.0735646,0.0796824,0.0857973,0.091909,0.0980171,0.104122,0.110222,0.116319,0.122411,0.128498,0.134581,0.140658,0.14673,0.152797,0.158858,0.164913,0.170962,0.177004,0.18304,0.189069,
0.19509,0.201105,0.207111,0.21311,0.219101,0.225084,0.231058,0.237024,0.24298,0.248928,0.254866,0.260794,0.266713,0.272621,0.27852,0.284408,0.290285,0.296151,0.302006,0.30785,0.313682,0.319502,0.32531,0.331106,0.33689,0.342661,0.348419,0.354164,0.359895,0.365613,0.371317,0.377007,
0.382683,0.388345,0.393992,0.399624,0.405241,0.410843,0.41643,0.422,0.427555,0.433094,0.438616,0.444122,0.449611,0.455084,0.460539,0.465976,0.471397,0.476799,0.482184,0.48755,0.492898,0.498228,0.503538,0.50883,0.514103,0.519356,0.52459,0.529804,0.534998,0.540171,0.545325,0.550458,
0.55557,0.560662,0.565732,0.570781,0.575808,0.580814,0.585798,0.59076,0.595699,0.600616,0.605511,0.610383,0.615232,0.620057,0.624859,0.629638,0.634393,0.639124,0.643832,0.648514,0.653173,0.657807,0.662416,0.667,0.671559,0.676093,0.680601,0.685084,0.689541,0.693971,0.698376,0.702755,
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-0.19509,-0.189069,-0.18304,-0.177004,-0.170962,-0.164913,-0.158858,-0.152797,-0.14673,-0.140658,-0.134581,-0.128498,-0.122411,-0.116319,-0.110222,-0.104122,-0.0980171,-0.091909,-0.0857973,-0.0796824,-0.0735646,-0.0674439,-0.0613207,-0.0551952,-0.0490677,-0.0429383,-0.0368072,-0.0306748,-0.0245412,-0.0184067,-0.0122715,-0.00613588
};


extern uint16_t  mt6816_count;//编码器计数值
uint16_t bias = 0;
int16_t  Scope[200];
uint16_t angledata[200]={0};


void get_scope(void)//从储存获取每个扇区长度,s_num为扇区总数
{
	Flash_Read_Angle (angledata );
	Flash_Read_Angle (angledata );
  for(uint8_t i=0;i<200 ;i++)
	{
    if(i!=199)
		Scope[i] =DIR* (int16_t )(angledata[i+1] -angledata [i]);//每步对应角度存在flash中，计算每步的电角度大小减少之后的计算量
		else Scope[i] =DIR* (int16_t )(angledata [0] -angledata [i]);
		if(abs (Scope[i]) > 2000)		//200只是个概数/实际数据是82左右，大于200说明越过零点
		{

			Scope[i]=16384+Scope[i];
			bias = i;
		}
	}
	//第一个和最后一个取平均值,因为不一定完全走了一圈会有点误差，平均值可以减小该误差
	Scope [199]=(Scope [0]+Scope [199]+Scope [198]+Scope [1])*0.25;
	//Scope [199]=Scope [0];

}

void FOC_Init(void)
{
	//读取编码器方向
	if(flash_read_dir (DIR_AD)==11)
	 DIR=1;
	else DIR=-1;
	
	set_uduq(&m1_foc ,0,0.5);
	foc_open(&m1_foc ,0);//电角度0初始化
	HAL_Delay (100);
	m1_foc.lead_angle = 256;	//这里对齐的Q轴，电角度需要超前256度左右，电机可能有误差该值可小范围改动,正速度大减小此值，正速度小增大此值
  get_scope ();
}

void Sector_tracker(void)//寻找扇区，找到电角度
{
	int temp = (DIR*(mt6816_count / 82) + bias+200) % 200;//计算转子当前的扇区
	for(int i=temp-1;i<=temp+1;i++)
	{
			if(DIR==1)
				{
				if(angledata[i+1] > angledata[i])
				{
					if(mt6816_count >= angledata[i] && mt6816_count <= angledata[i+1])
					{
						m1_foc.angle_sector = (i+200)%200;
						break;
					}
				}
				else if(angledata[i+1] < angledata[i])
				{
					if(mt6816_count >= angledata[i] && mt6816_count <= (angledata[i+1] + 16384))
					{
						m1_foc.angle_sector = (i+200)%200;
						break;
					}
				}
			 }
		else 				
		 {
					if(angledata[i+1] < angledata[i])
				{
					if(mt6816_count <= angledata[i] && mt6816_count >= angledata[i+1])
					{
						m1_foc.angle_sector = (i+200)%200;
						break;
					}
				}
				else if(angledata[i+1] > angledata[i])
				{
					if(mt6816_count <= angledata[i] && (mt6816_count+ 16384) >= (angledata[i+1]))
					{
						m1_foc.angle_sector = (i+200)%200;
						break;
					}
				}		
		}
		 
	}
	m1_foc.scope = Scope[m1_foc.angle_sector];
	if(DIR*angledata[(m1_foc.angle_sector+1)%200] > DIR*angledata[m1_foc.angle_sector])//计算电角度
		m1_foc.angle = DIR*(mt6816_count - angledata[m1_foc.angle_sector]) * 256 / m1_foc.scope;
	else
	{
		if(DIR==1)
		{
		if(mt6816_count > 16200)		//16200只是个概数
			m1_foc.angle = (mt6816_count - angledata[m1_foc.angle_sector]) * 256 / m1_foc.scope;
		else
			m1_foc.angle = (16384 - angledata[m1_foc.angle_sector] + mt6816_count) * 256 / m1_foc.scope;
	  }
		else 
		{
				 if(mt6816_count > 16200)
				{
					m1_foc.angle = (16384 + angledata[m1_foc.angle_sector] - mt6816_count) * 256 / m1_foc.scope;
				}
				else
				m1_foc.angle = (-mt6816_count + angledata[m1_foc.angle_sector]) * 256 / m1_foc.scope;
				
		}
	}
}



void setfoc_angle( foc_TypeDef *mfoc,uint16_t angle)//设置电角度
{
  mfoc ->sintheta=sin_value[angle&0x03ff];
	mfoc ->costheta =sin_value [(angle+256)%1024];

}

void repark_transfer( foc_TypeDef *mfoc)//repark变换
{
	mfoc ->Ualpha =mfoc ->costheta * mfoc ->Ud - mfoc ->sintheta * mfoc ->Uq ;
	mfoc ->Ubeta =mfoc ->sintheta * mfoc ->Ud + mfoc ->costheta  * mfoc ->Uq ;
}

void svpwmctr( foc_TypeDef *mfoc )//pwm调制
{
 float ualpha=fabs(mfoc->Ualpha);
 float ubeta=fabs(mfoc->Ubeta );
 if(mfoc->Ualpha>=0&&mfoc->Ubeta>=0)//A+B+
	 mfoc ->sector =1;
 else if(mfoc->Ualpha<0&&mfoc->Ubeta>=0)//A-B+
	 mfoc ->sector =2;
 else if(mfoc->Ualpha<0&&mfoc->Ubeta<0)//A-B-
	 mfoc ->sector =3;
 else if(mfoc->Ualpha>=0&&mfoc->Ubeta<0)//A+B-
	 mfoc ->sector =4;
 mfoc->Ta=(uint16_t )(ualpha /mfoc ->Udc*mfoc ->Ts);
 mfoc ->Tb=(uint16_t )(ubeta  /mfoc ->Udc*mfoc ->Ts);
}


//////////RZ7899MS
void set_duty_by_sector( foc_TypeDef *mfoc)
{
 switch(mfoc ->sector )
 {
 
	 case 1: //A+B+导通
	         HN4_set (mfoc ->Ts);HN3_set (mfoc ->Ts-mfoc ->Ta);//A+
					 HN2_set (mfoc ->Ts);HN1_set (mfoc ->Ts-mfoc ->Tb);//B+

		 break;
	 case 2: 
					//A-B+导通
					 HN3_set (mfoc ->Ts);HN4_set (mfoc ->Ts-mfoc ->Ta );//A-
	         HN2_set (mfoc ->Ts);HN1_set (mfoc ->Ts-mfoc ->Tb);//B+
		 break ;
	 case 3:					
		       //A-B-导通
					 HN3_set (mfoc ->Ts);HN4_set (mfoc ->Ts-mfoc ->Ta );//A-
	         HN1_set (mfoc ->Ts);HN2_set (mfoc ->Ts-mfoc ->Tb);//B-
		 break ;
	 case 4:		       
		       //A+B-导通
					 HN4_set (mfoc ->Ts);HN3_set (mfoc ->Ts-mfoc ->Ta );//A+
	         HN1_set (mfoc ->Ts);HN2_set (mfoc ->Ts-mfoc ->Tb);//B-
		 break ;
	 default :break ;
 
 }


}



void set_uduq( foc_TypeDef *mfoc,float ud,float uq)
{
  if(ud>mfoc ->outmax )return ;
	else if(ud<-mfoc->outmax)return ;
  if(uq>mfoc-> outmax )return ;
	else if(uq<-mfoc ->outmax )return ;
	mfoc->Ud=ud;
	mfoc ->Uq=uq;
}



void foc_open( foc_TypeDef *mfoc,uint16_t  angle)//开环控制
{
  setfoc_angle(mfoc,angle );
	repark_transfer (mfoc);
	svpwmctr(mfoc);
  set_duty_by_sector(mfoc );
}


void park_transform( foc_TypeDef *mfoc)//电流park变换
{
  mfoc->Iq=-mfoc->Ialpha*mfoc->sintheta + mfoc->Ibeta * mfoc->costheta ;
  mfoc->Id=mfoc->Ialpha*mfoc->costheta  + mfoc->Ibeta * mfoc->sintheta  ;
}


extern float current[2];
void get_AB_current( foc_TypeDef *mfoc)
{
   
	m1_foc .Ialpha=current [0]=ADCtoI*HAL_ADCEx_InjectedGetValue(&hadc1, ADC_INJECTED_RANK_2) -offet_I [0]-6;//A相电流
	m1_foc .Ibeta=current [1]=ADCtoI*HAL_ADCEx_InjectedGetValue(&hadc1, ADC_INJECTED_RANK_1) -offet_I [1]-6;//B相电流
	if(m1_foc .Ialpha <0)m1_foc .Ialpha *=1.15;
	if(m1_foc .Ibeta <0)m1_foc .Ibeta *=1.15;
// switch(mfoc ->sector)
// {
// 
//	 case 1: 	m1_foc .Ialpha =current [0];m1_foc .Ibeta =current[1] ;
//		 break;
//	 case 2:  m1_foc .Ialpha =-current [0];m1_foc .Ibeta =current[1] ;
//		 break ;
//	 case 3: 	 m1_foc .Ialpha =-current [0];m1_foc .Ibeta =-current[1] ;
//		 break ;
//	 case 4:   m1_foc .Ialpha =current [0];m1_foc .Ibeta =-current[1] ;
//		 break ;
//	 default :break ;
// 
// }

}

extern float current[2];
float  PID_factor=1;//PID调节因子
void adjust_I(void)
{
   current [0]=ADCtoI*HAL_ADCEx_InjectedGetValue(&hadc1, ADC_INJECTED_RANK_2)-6;//A相电流
   current [1]=ADCtoI*HAL_ADCEx_InjectedGetValue(&hadc1, ADC_INJECTED_RANK_1)-6;//B相电流
}

extern float vol;
void can_foc_init(void)
{
  m1_foc .Ts=900;
	m1_foc .Udc=12;
  m1_foc .outmax =10;
	
	if(PID_factor >10||PID_factor <0.1)PID_factor =1;//限制调节因子
//	m1_foc .kp =(4-vol*0.08)*PID_factor;
//	m1_foc .ki =(0.04-vol*0.0008)*PID_factor;
	
	m1_foc .kp =1.2*PID_factor;
	m1_foc .ki =0.02*PID_factor;
	if(m1_foc .ki>0.1)m1_foc .ki=0.1;//限制积分因子
	
	m1_foc .kd=0.0;

	m1_foc .tar_Id  =0.0;
	m1_foc .tar_Iq  =-0;
	
	m1_foc .id_err =0;
	m1_foc .iq_err =0;
	m1_foc .id_inter =0;
	m1_foc .iq_inter=0;
	
  m1_foc .Ls=0.00002;
	m1_foc .FLux=0.0035;
	
}	

extern 	uint32_t add_angle;
void b_foc_init(void)
{	
	   PID_factor = (*(__IO uint32_t *)(FLASH_USER_START_ADDR +0x400))*0.01;
     can_foc_init();//FOC参数初始化
		 FOC_Init();
		 set_uduq(&m1_foc ,0,0);
		 foc_open (&m1_foc ,0);
	
		for(uint8_t jj=0;jj<250;jj++)
		{
		 add_angle +=REIN_MT6816_GetAngleData();
			HAL_Delay (1);
		}
		encoder_last_count=mt6816_count=	init_angle =add_angle/250;//编码器初始化赋值
}



void set_foc_Iqcurrent( foc_TypeDef *mfoc,float current)
{
	if(current >System_MAX_I)current =System_MAX_I;
	else if(current <-System_MAX_I)current =-System_MAX_I;
  mfoc ->tar_Iq =current ;
}

extern  float w_Uq;
extern uint8_t limit_vol;
#define Omax 8
void foc_current_pid( foc_TypeDef *mfoc)//电流pid
{
  
	
	//计算误差
	mfoc ->id_err =mfoc ->tar_Id - mfoc ->Id ;
	mfoc ->iq_err=mfoc ->tar_Iq  - mfoc ->Iq ;

	//积分项
	mfoc->id_inter+=mfoc->ki*mfoc ->id_err ;
	mfoc->iq_inter +=mfoc->ki *mfoc->iq_err ;
	
	
	  //积分限幅
	if(mfoc ->id_inter > 8 )
		mfoc->id_inter =8 ;
	if(mfoc->id_inter <-8 )
		mfoc ->id_inter =-8 ;
	
	if(mfoc ->iq_inter > 10 )
		mfoc->iq_inter =10 ;
	if(mfoc->iq_inter <-10 )
		mfoc ->iq_inter =-10 ;
	
	//计算输出值
	mfoc ->Ud = mfoc ->kp *mfoc ->id_err +  mfoc->id_inter + mfoc->kd*(mfoc->id_err -mfoc ->last_Id_err) ;
	mfoc ->Uq =mfoc ->kp *mfoc ->iq_err +  mfoc->iq_inter + mfoc->kd*(mfoc->iq_err -mfoc ->last_Iq_err)+w_Uq ;
	
	//输出限幅
	if(mfoc ->Ud  > Omax )
		mfoc->Ud =Omax ;
	if(mfoc->Ud <-Omax )
		mfoc ->Ud =-Omax ;

	if(mfoc ->Uq > Omax )
		mfoc->Uq =Omax ;
	if(mfoc->Uq <-Omax )
		mfoc ->Uq =-Omax ;
	
	mfoc ->last_Id_err =mfoc->id_err  ;	
	mfoc ->last_Iq_err =mfoc->iq_err  ;
}


void current_ctr( foc_TypeDef *mfoc,uint16_t  angle)//电流闭环控制
{
  setfoc_angle(mfoc,angle );
	park_transform (mfoc );
	foc_current_pid (mfoc );
	repark_transfer (mfoc);
	svpwmctr(mfoc);
  set_duty_by_sector(mfoc );

}


























